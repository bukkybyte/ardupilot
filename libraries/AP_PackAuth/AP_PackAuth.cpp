#include "AP_PackAuth.h"

#if AP_PACKAUTH_ENABLED

#include <AP_HAL/AP_HAL.h>
#include <AP_Math/AP_Math.h>
#include <GCS_MAVLink/GCS.h>

#include "smartpack_proto.h"
#if __has_include("smartpack_key.h")
#include "smartpack_key.h"
#else
#error "Copy libraries/AP_PackAuth/smartpack_key.h.example to smartpack_key.h and set your own key"
#endif

extern const AP_HAL::HAL& hal;

#define PKA_SCAN_MS      2000    // rescan period while a pack isn't found
#define PKA_RETRY_MS     1000    // gap between challenges to one pack
#define PKA_TIMEOUT_MS    400    // time a pack has to answer
#define PKA_REAUTH_MS    3000    // re-challenge each pack this often
#define PKA_FRESH_MS     8000    // arming needs a good answer at most this old
#define PKA_BEAT_MS      2000    // thread must beat within this
#define PKA_DETECT_MS   10000    // detection report period while unprovisioned
#define PKA_USE_TRIES       5    // attempts to get a flight counted by the pack

#if AP_PACKAUTH_PARAMS_ENABLED
const AP_Param::GroupInfo AP_PackAuth::var_info[] = {
    // @Param: BUS
    // @DisplayName: Pack authenticator I2C bus
    // @Description: I2C bus of the pack authenticators. -1 scans all buses for each pack.
    // @Range: -1 3
    // @RebootRequired: True
    // @User: Advanced
    AP_GROUPINFO("BUS", 1, AP_PackAuth, _bus, AP_PACKAUTH_BUS_DEFAULT),

    // @Param: ADDR
    // @DisplayName: First pack authenticator I2C address
    // @Description: I2C address of pack 1. Pack N is at ADDR + N - 1.
    // @Range: 0 119
    // @RebootRequired: True
    // @User: Advanced
    AP_GROUPINFO("ADDR", 2, AP_PackAuth, _addr, AP_PACKAUTH_ADDR_DEFAULT),

    // @Param: NUM
    // @DisplayName: Number of packs that must authenticate
    // @Description: Arming is refused unless every one of these packs has proven its identity.
    // @Range: 1 5
    // @RebootRequired: True
    // @User: Advanced
    AP_GROUPINFO("NUM", 3, AP_PackAuth, _num, AP_PACKAUTH_NUM_DEFAULT),

#if AP_PACKAUTH_CFG_SIGNED
    // @Param: S0
    // @DisplayName: Pack config signature word 0
    // @Description: Part of the signature binding ARMING_PKA_NUM to this autopilot. Generated by the provisioning tool, not set by hand.
    // @User: Advanced
    AP_GROUPINFO("S0", 4, AP_PackAuth, _s0, 0),

    // @Param: S1
    // @DisplayName: Pack config signature word 1
    // @Description: See ARMING_PKA_S0.
    // @User: Advanced
    AP_GROUPINFO("S1", 5, AP_PackAuth, _s1, 0),

    // @Param: S2
    // @DisplayName: Pack config signature word 2
    // @Description: See ARMING_PKA_S0.
    // @User: Advanced
    AP_GROUPINFO("S2", 6, AP_PackAuth, _s2, 0),

    // @Param: S3
    // @DisplayName: Pack config signature word 3
    // @Description: See ARMING_PKA_S0.
    // @User: Advanced
    AP_GROUPINFO("S3", 7, AP_PackAuth, _s3, 0),
#endif

    AP_GROUPEND
};
#endif

AP_PackAuth::AP_PackAuth()
{
#if AP_PACKAUTH_PARAMS_ENABLED
    AP_Param::setup_object_defaults(this, var_info);
#endif
}

uint8_t AP_PackAuth::num_packs() const
{
#if AP_PACKAUTH_PARAMS_ENABLED
    const int16_t n = _num;
#else
    const int16_t n = AP_PACKAUTH_NUM_DEFAULT;
#endif
    return (uint8_t)constrain_int16(n, AP_PACKAUTH_NUM_MIN, AP_PACKAUTH_MAX_PACKS);
}

#if AP_PACKAUTH_CFG_SIGNED
// SipHash-2-4(key, 0xC1 || count || cube unique id), compared with the four
// signature parameters. Generated off-line by tools/sign_config.py.
bool AP_PackAuth::cfg_valid() const
{
    const int8_t n = _num;
    if (n < 1 || n > AP_PACKAUTH_MAX_PACKS) {
        return false;
    }
    uint8_t uid[12] {};
    uint8_t len = sizeof(uid);
    if (!hal.util->get_system_id_unformatted(uid, len) || len != sizeof(uid)) {
        return false;
    }
    uint8_t msg[2 + sizeof(uid)];
    msg[0] = 0xC1;                          // keeps this MAC apart from pack responses
    msg[1] = (uint8_t)n;
    memcpy(&msg[2], uid, sizeof(uid));
    const uint64_t mac = smartpack_siphash24(SMARTPACK_KEY, msg, sizeof(msg));

    const uint16_t w[4] = { (uint16_t)_s0.get(), (uint16_t)_s1.get(),
                            (uint16_t)_s2.get(), (uint16_t)_s3.get() };
    uint16_t diff = 0;
    for (uint8_t i = 0; i < 4; i++) {
        diff |= (uint16_t)(((mac >> (16 * i)) & 0xFFFF) ^ w[i]);
    }
    return diff == 0;
}

// tell the installer how many genuine packs answered, plus the id to sign
void AP_PackAuth::report_detect()
{
    uint8_t found = 0;                      // slots must be contiguous from slot 1
    while (found < AP_PACKAUTH_MAX_PACKS && _pack[found].ok) {
        found++;
    }
    char hex[2 * 12 + 1] {};
    uint8_t uid[12] {};
    uint8_t len = sizeof(uid);
    if (hal.util->get_system_id_unformatted(uid, len) && len == sizeof(uid)) {
        for (uint8_t i = 0; i < sizeof(uid); i++) {
            hal.util->snprintf(&hex[2 * i], 3, "%02x", uid[i]);
        }
    }
    GCS_SEND_TEXT(MAV_SEVERITY_INFO, "PackAuth: %u pack(s) detected", (unsigned)found);
    GCS_SEND_TEXT(MAV_SEVERITY_INFO, "PackAuth cfg-id: %s", hex);
}
#endif  // AP_PACKAUTH_CFG_SIGNED

void AP_PackAuth::init()
{
    if (_started) {
        return;
    }
    _started = true;
    if (!hal.scheduler->thread_create(FUNCTOR_BIND_MEMBER(&AP_PackAuth::thread, void),
                                      "packauth", 3072, AP_HAL::Scheduler::PRIORITY_IO, 0)) {
        _thread_failed = true;     // gate stays closed
    }
}

bool AP_PackAuth::alive() const
{
    return _beat_ms != 0 && (AP_HAL::millis() - _beat_ms) < PKA_BEAT_MS;
}

bool AP_PackAuth::gate_check(char *buf, size_t len) const
{
    const uint8_t n = num_packs();
    const char *why = nullptr;
    if (_thread_failed)        { why = "thread failed"; }
    else if (!_started)        { why = "not started"; }
    else if (!alive())         { why = (_beat_ms == 0) ? "starting" : "task stalled"; }
    else if (!config_ok(n))    { why = "bad pack address config"; }
#if AP_PACKAUTH_CFG_SIGNED
    else if (!cfg_valid())     { why = "pack not signed"; }
#endif
    if (why != nullptr) {
        hal.util->snprintf(buf, len, "Pack auth: %s", why);
        return false;
    }

    const uint32_t now = AP_HAL::millis();
    for (uint8_t i = 0; i < n; i++) {
        const Pack &p = _pack[i];
        if (p.ok && (now - p.ok_ms) < PKA_FRESH_MS) {
            continue;
        }
        hal.util->snprintf(buf, len, "Pack %u: %s", (unsigned)(i + 1), p.ok ? "proof is stale" : p.why);
        return false;
    }
    // packs of different sets must not be mixed
    for (uint8_t i = 1; i < n; i++) {
        if (_pack[i].set_id != _pack[0].set_id) {
            hal.util->snprintf(buf, len, "Pack %u: other set", (unsigned)(i + 1));
            return false;
        }
    }
    return true;
}

void AP_PackAuth::thread()
{
    while (!hal.scheduler->is_system_initialized()) {
        hal.scheduler->delay(10);
    }
#if AP_PACKAUTH_CFG_SIGNED
    if (detect_mode()) {
        GCS_SEND_TEXT(MAV_SEVERITY_INFO, "PackAuth: count not signed, detecting");
    } else {
        GCS_SEND_TEXT(MAV_SEVERITY_INFO, "PackAuth: %u pack(s) required", (unsigned)num_packs());
    }
#else
    GCS_SEND_TEXT(MAV_SEVERITY_INFO, "PackAuth: %u pack(s) required", (unsigned)num_packs());
#endif

    while (true) {
        _beat_ms = AP_HAL::millis();

        // a flight is "valid" if the vehicle stayed armed long enough; count it on disarm
        const bool armed_now = hal.util->get_soft_armed();
        if (armed_now && !_was_armed) {
            _arm_start_ms = AP_HAL::millis();
        } else if (!armed_now && _was_armed &&
                   (AP_HAL::millis() - _arm_start_ms) >= (uint32_t)AP_PACKAUTH_MIN_FLIGHT_S * 1000U) {
            const uint8_t np = num_packs();
            for (uint8_t k = 0; k < np; k++) {
                _pack[k].use_base = _pack[k].count;
                _pack[k].use_tries = 0;
                _pack[k].use_pending = true;
            }
        }
        _was_armed = armed_now;

        bool detect = false;
#if AP_PACKAUTH_CFG_SIGNED
        detect = detect_mode();
#endif
        const uint8_t n = detect ? AP_PACKAUTH_MAX_PACKS : num_packs();
        if (config_ok(n)) {
            for (uint8_t i = 0; i < n; i++) {
                step(i);
                _beat_ms = AP_HAL::millis();
            }
        }

#if AP_PACKAUTH_CFG_SIGNED
        if (detect && !hal.util->get_soft_armed() &&
            (AP_HAL::millis() - _detect_ms) > PKA_DETECT_MS) {
            _detect_ms = AP_HAL::millis();
            report_detect();
        }
#endif
#if AP_PACKAUTH_DEBUG
        debug_print();
#endif
        hal.scheduler->delay(100);
    }
}

void AP_PackAuth::step(uint8_t i)
{
    if (hal.util->get_soft_armed()) {
        return;                               // never touch the bus while armed
    }

    Pack &p = _pack[i];
    const uint32_t now = AP_HAL::millis();

    if (!p.dev) {
        if (now - p.last_scan_ms < PKA_SCAN_MS) {
            return;
        }
        p.last_scan_ms = now;
        find_device(i);
        if (!p.dev) {
            p.why = "pack not found";
            return;
        }
    }

    if (p.ok) {
        if (now - p.ok_ms > PKA_FRESH_MS) {
            p.ok = false;                     // proof went stale
            p.why = "pack stopped answering";
        } else if (!p.use_pending && now - p.ok_ms < PKA_REAUTH_MS) {
            return;                           // proven recently
        }
    }

    if (now - p.last_try_ms < PKA_RETRY_MS) {
        return;
    }
    p.last_try_ms = now;
    challenge(i);
}

void AP_PackAuth::find_device(uint8_t i)
{
    Pack &p = _pack[i];
    const uint8_t addr = addr_for(i);
    const int8_t want = cfg_bus();

    if (want >= 0) {
        // fixed bus: trust the setting, the challenge shows if nothing answers
        p.bus_found = want;
        p.dev = hal.i2c_mgr->get_device(want, addr, 100000, true, 20);
        return;
    }

    const uint32_t mask = hal.i2c_mgr->get_bus_mask();   // all buses
#if AP_PACKAUTH_DEBUG
    _scan_mask = mask;
#endif
    p.n_scans++;
    for (uint8_t b = 0; b < 8; b++) {
        if (!(mask & (1U << b))) {
            continue;
        }
        if (probe(b, addr)) {
            p.bus_found = b;
            p.dev = hal.i2c_mgr->get_device(b, addr, 100000, true, 20);
            return;
        }
    }
}

// does something at addr on this bus answer our STATUS register with a valid value?
bool AP_PackAuth::probe(uint8_t bus, uint8_t addr)
{
    auto d = hal.i2c_mgr->get_device(bus, addr, 100000, true, 20);
    if (!d) {
        return false;
    }
    d->set_retries(2);
    WITH_SEMAPHORE(d->get_semaphore());
    uint8_t st = 0xFF;
    return d->read_registers(SMARTPACK_REG_STATUS, &st, 1) && st <= SMARTPACK_ST_READY;
}

void AP_PackAuth::challenge(uint8_t i)
{
    Pack &p = _pack[i];

    // 1. the pack's record: serial, set, activation date, use count, max count
    uint8_t info[SMARTPACK_INFO_LEN];
    {
        WITH_SEMAPHORE(p.dev->get_semaphore());
        if (!p.dev->read_registers(SMARTPACK_REG_INFO, info, sizeof(info))) {
            p.n_xfer_fail++;
            p.ok = false;
            p.why = "check connection";
            return;
        }
    }
    const uint16_t serial = smartpack_le16(&info[0]);
    p.serial = serial;
    if (p.ok && serial != p.ok_serial) {
        p.ok = false;                         // a different pack: trust nothing
    }

    // 2. fresh random challenge
    uint8_t nonce[SMARTPACK_NONCE_LEN];
    if (!hal.util->get_random_vals(nonce, sizeof(nonce))) {
        for (uint8_t k = 0; k < sizeof(nonce); k++) {
            nonce[k] = get_random16() & 0xFF;
        }
    }
    uint8_t pkt[1 + SMARTPACK_NONCE_LEN];
    pkt[0] = SMARTPACK_REG_NONCE;
    memcpy(&pkt[1], nonce, sizeof(nonce));
    {
        WITH_SEMAPHORE(p.dev->get_semaphore());
        if (!p.dev->transfer(pkt, sizeof(pkt), nullptr, 0)) {
            p.n_xfer_fail++;
            p.ok = false;
            p.why = "nonce write failed";
            return;
        }
    }
    p.n_sent++;

    // 3. wait for READY; the pack never stretches the clock
    uint8_t resp[SMARTPACK_RESPONSE_LEN];
    bool ready = false;
    const uint32_t t0 = AP_HAL::millis();
    while (AP_HAL::millis() - t0 < PKA_TIMEOUT_MS) {
        hal.scheduler->delay(20);
        _beat_ms = AP_HAL::millis();
        WITH_SEMAPHORE(p.dev->get_semaphore());
        uint8_t st = 0xFF;
        if (!p.dev->read_registers(SMARTPACK_REG_STATUS, &st, 1)) {
            p.n_xfer_fail++;
            continue;
        }
        p.last_status = st;
        if (st == SMARTPACK_ST_READY) {
            ready = p.dev->read_registers(SMARTPACK_REG_RESPONSE, resp, sizeof(resp));
            if (!ready) {
                p.n_xfer_fail++;
            }
            break;
        }
    }
    if (!ready) {
        p.n_timeout++;
        p.ok = false;
        p.why = "pack not responding";
        return;
    }

    // 4. verify without early exit; the MAC covers the whole record
    uint8_t expected[SMARTPACK_RESPONSE_LEN];
    smartpack_compute_response(SMARTPACK_KEY, nonce, info, expected);
    uint8_t diff = 0;
    for (uint8_t k = 0; k < sizeof(resp); k++) {
        diff |= expected[k] ^ resp[k];
    }
    if (diff != 0) {
        p.ok = false;                         // a wrong answer revokes trust
        p.n_bad++;
        p.why = "wrong response";
        return;
    }

    // genuine pack: its record can be trusted now
    p.set_id = smartpack_le32(&info[2]);
    p.activated = smartpack_le32(&info[6]);
    p.count = smartpack_le16(&info[10]);
    p.max_count = smartpack_le16(&info[12]);

    // 5. a flight has finished: report one use to the pack (authenticated, one-shot)
    if (p.use_pending) {
        if (p.count > p.use_base) {
            p.use_pending = false;            // the pack counted it
            GCS_SEND_TEXT(MAV_SEVERITY_INFO, "Pack %u: use %u/%u",
                          (unsigned)(i + 1), (unsigned)p.count, (unsigned)p.max_count);
        } else if (p.use_tries < PKA_USE_TRIES) {
            uint8_t mac[SMARTPACK_USE_LEN];
            smartpack_compute_use_mac(SMARTPACK_KEY, nonce, info, mac);
            uint8_t upkt[1 + SMARTPACK_USE_LEN];
            upkt[0] = SMARTPACK_REG_USE;
            memcpy(&upkt[1], mac, sizeof(mac));
            WITH_SEMAPHORE(p.dev->get_semaphore());
            if (!p.dev->transfer(upkt, sizeof(upkt), nullptr, 0)) {
                p.n_xfer_fail++;
            }
            p.use_tries++;
        } else {
            p.use_pending = false;
            GCS_SEND_TEXT(MAV_SEVERITY_INFO, "Pack %u: use not saved", (unsigned)(i + 1));
        }
    }

    // 6. policy on the authenticated record
    if (serial == 0 || p.set_id == 0 || p.max_count == 0) {
        p.ok = false;
        p.why = "pack not provisioned";
        return;
    }
    if (p.count >= p.max_count) {
        p.ok = false;
        p.why = "life used up";
        return;
    }

    const bool was_ok = p.ok;
    p.ok_serial = serial;
    p.ok_ms = AP_HAL::millis();
    p.ok = true;
    p.n_ok++;
    p.why = "authenticated";
    if (!was_ok) {
        GCS_SEND_TEXT(MAV_SEVERITY_INFO, "Pack %u: #%u set %lu use %u/%u", (unsigned)(i + 1),
                      (unsigned)serial, (unsigned long)p.set_id,
                      (unsigned)p.count, (unsigned)p.max_count);
    }
}

#if AP_PACKAUTH_DEBUG
void AP_PackAuth::debug_print()
{
    const uint32_t now = AP_HAL::millis();
    if (now - _dbg_ms < 5000 || hal.util->get_soft_armed()) {
        return;
    }
    _dbg_ms = now;
    const uint8_t n = num_packs();
    uint8_t good = 0;
    for (uint8_t i = 0; i < n; i++) {
        if (_pack[i].ok) {
            good++;
        }
    }
    GCS_SEND_TEXT(MAV_SEVERITY_INFO, "PKA need=%u ok=%u mask=0x%lx",
                  (unsigned)n, (unsigned)good, (unsigned long)_scan_mask);
    for (uint8_t i = 0; i < n; i++) {
        const Pack &p = _pack[i];
        GCS_SEND_TEXT(MAV_SEVERITY_INFO, "PKA%u bus=%d ok=%u ser=%ld %s",
                      (unsigned)(i + 1), (int)p.bus_found, p.ok ? 1U : 0U, (long)p.serial, p.why);
        if (p.ok) {
            GCS_SEND_TEXT(MAV_SEVERITY_INFO, "PKA%u set=%lu d=%lu use=%u/%u", (unsigned)(i + 1),
                          (unsigned long)p.set_id, (unsigned long)p.activated,
                          (unsigned)p.count, (unsigned)p.max_count);
        } else {
            GCS_SEND_TEXT(MAV_SEVERITY_INFO, "PKA%u tx=%u ok=%u bad=%u xf=%u to=%u",
                          (unsigned)(i + 1), (unsigned)p.n_sent, (unsigned)p.n_ok,
                          (unsigned)p.n_bad, (unsigned)p.n_xfer_fail, (unsigned)p.n_timeout);
        }
    }
}
#endif

#endif  // AP_PACKAUTH_ENABLED